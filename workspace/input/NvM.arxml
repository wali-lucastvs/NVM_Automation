AUTOSAR XML (schema 4-0-2)
package /NvM
  ecuc-module-configuration-values definition=NvM:
    3 x NvMBlockDescriptor:
      OdometerMirror: NvMNvramBlockIdentifier=3, NvMNvBlockLength=32, NvMBlockManagementType=NVM_BLOCK_REDUNDANT, NvMBlockUseCrc=1, NvMBlockWriteProt=1, NvMNvramDeviceId=1, NvMNvBlockBaseNumber=3, NvMNvBlockNum=2, NvMRamBlockDataAddress=Ram_OdometerMirror, NvMBlockCrcType=NVM_CRC32
      DiagnosticSnapshot: NvMNvramBlockIdentifier=4, NvMNvBlockLength=64, NvMBlockManagementType=NVM_BLOCK_DATASET, NvMBlockUseCrc=0, NvMBlockWriteProt=0, NvMNvramDeviceId=0, NvMNvBlockBaseNumber=4, NvMNvBlockNum=2, NvMRamBlockDataAddress=Ram_DiagnosticSnapshot
      EngineSettings: NvMNvramBlockIdentifier=20, NvMNvBlockLength=128, NvMBlockManagementType=NVM_BLOCK_NATIVE, NvMBlockUseCrc=1, NvMBlockWriteProt=0, NvMNvramDeviceId=0, NvMNvBlockBaseNumber=20, NvMNvBlockNum=1, NvMRamBlockDataAddress=Ram_EngineSettings, NvMBlockCrcType=NVM_CRC16
