AUTOSAR XML (schema 00049)
package /NvM
  module config NvM_Config: definition=NvM
    LegacyBlock (NvMBlockDescriptor):
      NvMNvramBlockIdentifier = 10
      NvMNvBlockLength = 8
      NvMBlockManagementType = NVM_BLOCK_NATIVE
      NvMBlockUseCrc = 1
      NvMBlockWriteProt = 0
      NvMNvramDeviceId = 0
      NvMNvBlockBaseNumber = 10
      NvMNvBlockNum = 1
      NvMRamBlockDataAddress = Ram_LegacyBlock
      NvMBlockCrcType = NVM_CRC16
