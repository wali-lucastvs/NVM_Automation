AUTOSAR XML (schema 00049)
package /NvM
  module config NvM_Config: definition=NvM
    5 x NvMBlockDescriptor:
      WaliBlock: NvMNvramBlockIdentifier=10, NvMNvBlockLength=8, NvMBlockManagementType=NVM_BLOCK_NATIVE, NvMBlockUseCrc=1, NvMBlockWriteProt=0, NvMNvramDeviceId=0, NvMNvBlockBaseNumber=10, NvMNvBlockNum=1, NvMRamBlockDataAddress=Ram_LegacyBlock, NvMBlockCrcType=NVM_CRC16
      Haider: NvMNvramBlockIdentifier=3, NvMNvBlockLength=16, NvMBlockManagementType=NVM_BLOCK_REDUNDANT, NvMBlockUseCrc=1, NvMBlockWriteProt=1, NvMNvramDeviceId=1, NvMNvBlockBaseNumber=3, NvMNvBlockNum=2, NvMRamBlockDataAddress=Ram_OdometerMirror, NvMBlockCrcType=NVM_CRC32
      Zaidi: NvMNvramBlockIdentifier=4, NvMNvBlockLength=128, NvMBlockManagementType=NVM_BLOCK_DATASET, NvMBlockUseCrc=0, NvMBlockWriteProt=0, NvMNvramDeviceId=0, NvMNvBlockBaseNumber=4, NvMNvBlockNum=2, NvMRamBlockDataAddress=Ram_DiagnosticSnapshot
      EngineSettings: NvMNvramBlockIdentifier=20, NvMNvBlockLength=64, NvMBlockManagementType=NVM_BLOCK_NATIVE, NvMBlockUseCrc=1, NvMBlockWriteProt=0, NvMNvramDeviceId=0, NvMNvBlockBaseNumber=20, NvMNvBlockNum=1, NvMRamBlockDataAddress=Ram_EngineSettings, NvMBlockCrcType=NVM_CRC16
      Wali: NvMNvramBlockIdentifier=2, NvMNvBlockLength=64, NvMBlockManagementType=NVM_BLOCK_NATIVE, NvMBlockUseCrc=1, NvMBlockWriteProt=0, NvMNvramDeviceId=0, NvMNvBlockBaseNumber=2, NvMNvBlockNum=1, NvMRamBlockDataAddress=Ram_EngineSettings, NvMBlockCrcType=NVM_CRC16
